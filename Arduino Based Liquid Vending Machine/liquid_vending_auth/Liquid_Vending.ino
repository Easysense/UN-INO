#include <LiquidCrystal.h>
LiquidCrystal lcd(4,5,6,7,8,9); //(RS, EN, D4, D5, D6, D7)

//you can add multiple tags no.
String tag1="4A00C3978B95";//you can change tag no.
String tag2="4A00C35BBA86";

byte statusLed    = 13;
byte sensorInterrupt = 0;  // 0 = digital pin 2
byte sensorPin       = 2;

int tap=3;//relay is connected which triger solenoid

float calibrationFactor = 4.5;

volatile byte pulseCount;  

float flowRate;
unsigned int flowMilliLitres;
unsigned long totalMilliLitres;
unsigned long quantity =1000;//1000ml-you can change as per your requirment
unsigned long flow_reading = 0;
unsigned long oldTime;

void setup()
{
  Serial.begin(9600);
  lcd.begin(16,2);
  lcd.setCursor(5,0);
  lcd.print("Welcome");
  lcd.setCursor(0,1);
  lcd.print("Swipe RFID tag");
  
  pinMode(statusLed, OUTPUT);
  pinMode(tap,OUTPUT);
  digitalWrite(statusLed, HIGH); 
  
  while(!Serial.available()){
    delay(1000);
  }
 
  digitalWrite(tap, HIGH);
  pinMode(sensorPin, INPUT);
  digitalWrite(sensorPin, HIGH);

  pulseCount        = 0;
  flowRate          = 0.0;
  flowMilliLitres   = 0;
  totalMilliLitres  = 0;
  oldTime           = 0;
  attachInterrupt(sensorInterrupt, pulseCounter, FALLING);
}
void loop()
{
String tagdata=Serial.readString();
if(tagdata==tag1)//person1 tag match if match he/she will get 1litre of liquid
{
  lcd.clear();
  lcd.setCursor(2,0);
  lcd.print("Place your pot");
  lcd.setCursor(4,1);
  lcd.print("person1");
  digitalWrite(tap,1);
  while(flow_reading < quantity){
                    flow_reading = getFlowData();
                    lcd.clear();
                    lcd.setCursor(0,0);
                    lcd.print("Flow Amount ");
                    lcd.setCursor(0,1);
                    lcd.print(flow_reading);

                    delay(1000);
                    
                 }
            
                 //solenoid  to close via relay
                 digitalWrite(tap, LOW);
                 
}

else if(tagdata==tag2)//person2 tag match if match he/she will get 1litre of liquid
{
  lcd.clear();
  lcd.setCursor(0,0);
  lcd.print("put pot");
  lcd.setCursor(0,1);
  lcd.print("person 2");
  digitalWrite(tap,1);
   while(flow_reading < quantity){
                    flow_reading = getFlowData();
                    lcd.clear();
                    lcd.setCursor(0,0);
                    lcd.print("Flow Amount ");
                    lcd.setCursor(0,1);
                    lcd.print(flow_reading);

                    delay(1000);
                    
                 }
            
                 //solenoid  to close via relay
                 digitalWrite(tap, LOW);
                 lcd.clear();
                 lcd.setCursor(0,0);
                 lcd.print("Remove pot");
}
}
unsigned long getFlowData(){

  detachInterrupt(sensorInterrupt);

  flowRate = ((1000.0 / (millis() - oldTime)) * pulseCount) / calibrationFactor;

  oldTime = millis();

  flowMilliLitres = (flowRate / 60) * 1000;
  totalMilliLitres += flowMilliLitres;

  unsigned int frac;

 
  pulseCount = 0;
  attachInterrupt(sensorInterrupt, pulseCounter, FALLING);

  return totalMilliLitres;
  
}

void pulseCounter()
{
  // Increment the pulse counter
  pulseCount++;
}